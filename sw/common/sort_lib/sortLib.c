/*
-------------------------------------------------------------------------------
TYMPHANY LTD





                  Sort lib
                  -------------------------

                  SW Module Document




@file        sortLib.c
@brief       This file implements the basic sorting API
@author      Bob.Xu
@date        2014-12-18
@copyright (c) Tymphany Ltd. All rights reserved.

Change History:
VERSION    : 1    DRAFT      2014-02-17     Bob.Xu
DESCRIPTION: First Draft. Generated by newclass.py
SCO/ERROR  :
-------------------------------------------------------------------------------
*/
#include "sortLib.h"
static int split(int32 *pArray, int16 left, int16 right)
{
    int16 indexLower, indexHigher;
    int32 baseValue, temp;

    indexLower = left + 1;
    indexHigher = right;
    baseValue = pArray[left];

    while ( indexHigher >= indexLower )
    {
      while (pArray[indexLower] <= baseValue)
      {
          indexLower++;
      }
      while (pArray[indexHigher] > baseValue)
      {
          indexHigher--;
      }
      if (indexHigher > indexLower)
      {
          temp = pArray[indexLower];
          pArray[indexLower] = pArray[indexHigher];
          pArray[indexHigher] = temp;
      }
    }

    temp = pArray[left];
    pArray[left] = pArray[indexHigher];
    pArray[indexHigher] = temp;

    return indexHigher;
}

void tpQsort(int32 *pArray, int16 left, int16 right)
{
    int16 i;
    if (right > left)
    {
        i = split(pArray, left, right);
        tpQsort(pArray, left, i - 1);
        tpQsort(pArray, i + 1, right);
    }
}

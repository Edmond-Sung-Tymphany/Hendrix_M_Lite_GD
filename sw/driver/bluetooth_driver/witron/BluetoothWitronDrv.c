/*
-------------------------------------------------------------------------------
TYMPHANY LTD





                  BluetoothWitron Driver
                  -------------------------

                  SW Module Document




@file        BluetoothWitronDrv.c
@brief       BT driver for Witron supplied modules.
@author      Edmond Sung 
@date        2014-02-10
@copyright (c) Tymphany Ltd. All rights reserved.

Change History:
VERSION    : 1    DRAFT      2014-02-10     Chris Alexander 
REASON     : First Draft. Generated by newclass.py
SCO/ERROR  : 

VERSION    : 2    BETA      2014-02-10     Edmond Sung
REASON     : First implementation.
SCO/ERROR  : 
-------------------------------------------------------------------------------
*/

#define "./BluetoothDrvWitron_priv.h"

const int TxSize = 100;
const int RxSize = 100;
static char TxData[TxSize];
static char RxData[RxSize];
static cRingBuf rxBuf;
static cRingBuf txBuf;
static cUartDrv UartDrv;

/**********************************************************************************
 Purpose          : Convert the ascii character to HEX value.
 Argument         : pointer to a ascii character
 Return Value     : HEX value
 Comment:         : 
**********************************************************************************/
static uint8 convert_ascii2hex(uint8* ascii_dat)
{
    if (ascii_dat[0]>='0' && ascii_dat[0]<='9')
        ascii_dat[0]=(ascii_dat[0]-'0');
    else (ascii_dat[0]>='a' && ascii_dat[0]<='f')
        ascii_dat[0]=(ascii_dat[0]-'a'+0x0a);
    else (ascii_dat[0]>='A' && ascii_dat[0]<='F')
        ascii_dat[0]=(ascii_dat[0]-'F'+0x0a);
    else
        ascii_dat[0]=0;
    return (ascii_dat[0]);
}


const uint8 bluetooth_avrcp_command_table[END_AVRCP_CMD]=
{
    WITRON_AVRCP_CMD_PLAY,
    WITRON_AVRCP_CMD_PAUSE,
    WITRON_AVRCP_CMD_STOP,
    WITRON_AVRCP_CMD_SKIP_FORWARD,
    WITRON_AVRCP_CMD_SKIP_BACKWARD,
    WITRON_AVRCP_CMD_FF_PRESS,
    WITRON_AVRCP_CMD_FF_RELEASE,
    WITRON_AVRCP_CMD_REWIND_PRESS,
    WITRON_AVRCP_CMD_REWIND_RELEASE,
    WITRON_AVRCP_CMD_PLAY_PAUSE
}

const uint8 bluetooth_test_mode_table[END_BT_TEST_MODE]=
{
    WITRON_BT_DUT_MODE,
    WITRON_BT_TX_CONT_MODE,
    WITRON_BT_PCM_LOOPBACK,
    WITRON_BT_A2DP_CODEC,
    WITRON_BT_STEREO_CODEC_LOOPBACK,
}


/**********************************************************************************
 Purpose          : Command send the message through a uart port.
 Argument         : void
 Return Value     : void
 Comment:         :
**********************************************************************************/
void BluetoothDrv_Init()
{
    RingBuf_Ctor(txBuf, TxData, TxSize);
    RingBuf_Ctor(rxBuf, RxData, RxSize);
    UartDrv_Ctor(UartDrv, config, txBuf, rxBuf);
}

/**********************************************************************************
 Purpose          : Command send the message through a uart port.
 Argument         : void
 Return Value     : void
 Comment:         : 
**********************************************************************************/
static void Bluetooth_Witron_command_send(uint16 id, uint16 length, uint8* payload)
{
    uint8 tmpTxbuf[22];
    uint8 i;
    tmpTxbuf[0]=(uint8)(id&0xff);
    tmpTxbuf[1]=(uint8)(id>>8);
    tmpTxbuf[2]=(uint8)(length&0xff);
    tmpTxbuf[3]=(uint8)(length>>8);

    for(i=0;i<length;i++)
    {
        tmpTxbuf[4+i]=*payload++;
    }
    
    //Uart_tx_packet(tmpTxbuf,4+length);  
    UartDrv_Write(UartDrv, tmpTxbuf, 22);
}

/**********************************************************************************
 Purpose          : Command to startup the bluetooth module
 Argument         : void
 Return Value     : void
 Comment          : 
**********************************************************************************/
void BluetoothDrv_Startup(void)
{
    Bluetooth_Witron_command_send(GEN_STARTUP_REQ_ID, 0x0000, NULL);
}

/**********************************************************************************
 Purpose          :	Command to shutdown the bluetooth module
 Argument         : void
 Return Value     : void
 Comment:		  : 
**********************************************************************************/
void BluetoothDrv_Shutdown(void)
{
    Bluetooth_Witron_command_send(GEN_SHUTDOWN_REQ_ID, 0x0000, NULL);
}

/**********************************************************************************
 Purpose          :	Command to enter the bluetooth pairing mode 
 Argument         : 
 Return Value     : pointer to a string of the assigned device name
 Comment:		  : 
**********************************************************************************/
void BluetoothDrv_EnterPairing(uint8 seconds)
{
    uint8 tmp[2];
    tmp[0]=seconds;
    tmp[1]=0;
    Bluetooth_Witron_command_send(GEN_ENTER_PAIRING_REQ_ID, 0x0002, tmp);
}

/**********************************************************************************
 Purpose          :	Command to set the bluetooth device name
 Argument         : pointer to a string of the assigned device name
 Return Value     : 
 Comment:		  : 
**********************************************************************************/
void BluetoothDrv_SetLocalDeviceName(uint8* device_name)
{
    uint8 tmp[18]={0x10,0x00,0x00,0x00,0x00,0x00,0x00,0x00,0x00,0x00,0x00,0x00,0x00,0x00,0x00,0x00,0x00,0x00};
    memcpy(&tmp[2], device_name, sizeof(device_name));
    Bluetooth_Witron_command_send(GEN_SET_LOCAL_DEVICE_NAME_REQ_ID, 0x12, tmp);
}


/**********************************************************************************
 Purpose          :	Send AVRCP command to bluetooth module
 Argument         : AVRCP command
 Return Value     : 
 Comment:		  : 
**********************************************************************************/
void BluetoothDrv_AVRCPCmd(eAvrcpCmd  cmd)
{
    uint8 tmp[2];
    tmp[0]=(uint8)bluetooth_avrcp_command_table[cmd];
    tmp[1]=0;
    Bluetooth_Witron_command_send(AVRCP_SEND_CMD_REQ_ID, 2, tmp);
}

/**********************************************************************************
 Purpose          :	Command to playback the tone which is different from audio cue.
 Argument         : 
 Return Value     : 
 Comment:		  : 
**********************************************************************************/
void BluetoothDrv_DisconnectDevice(void)
{
    Bluetooth_Witron_command_send(GEN_DISCONNECT_REQ_ID, 0, NULL);
}

/**********************************************************************************
 Purpose          :	Command to playback the tone which is different from audio cue.
 Argument         : 
 Return Value     : 
 Comment:		  : 
**********************************************************************************/
void BluetoothDrv_PlayTone(uint8 tone_id)
{
    uint8 tmp[2];
    tmp[0]=tone_id;
    tmp[1]=0;
    Bluetooth_Witron_command_send(GEN_PLAY_TONE_REQ, 2, tmp);
}

/**********************************************************************************
 Purpose          :	Command to request bluetooth interal volume.
 Argument         : 
 Return Value     : 
 Comment:		  : 
**********************************************************************************/
void BluetoothDrv_GetVolume(void)
{
    Bluetooth_Witron_command_send(AV_GET_VOLUME_REQ_ID, 0, NULL);
}

/**********************************************************************************
 Purpose          :	Command to request bluetooth firmware version
 Argument         : 
 Return Value     : 
 Comment:		  : 
**********************************************************************************/
void BluetoothDrv_RequestVersion(void)
{
    Bluetooth_Witron_command_send(GEN_GET_SW_VERSION_REQ,0, NULL);
}

/**********************************************************************************
 Purpose          :	Command to playback the specific audio cue.
 Argument         : the duration of the pairing in second.
 Return Value     : 
 Comment:		  : 
**********************************************************************************/
void BluetoothDrv_ReqAudioCuePlayback(eBluetoothAudioCue audio_cue)
{
    uint8 tmp[2];
    tmp[0]=(uint8)audio_cue;
    tmp[1]=0x00;
    Bluetooth_Witron_command_send(GEN_PLAY_FILE_REQ_ID, 0x0002, tmp);
}

/**********************************************************************************
 Purpose          :	Command to enter True Wireless pairing state
 Argument         : the duration of the pairing in second.
 Return Value     : 
 Comment:		  : 
**********************************************************************************/
void BluetoothDrv_EnterTrueWirelessPairing(uint8 seconds)
{
    uint8 tmp[2];
    tmp[0]=seconds;
    tmp[1]=0;
    Bluetooth_Witron_command_send(TRUEWIRELESS_PAIR_REQ_ID, 2, tmp);
}

/**********************************************************************************
 Purpose          :	Command to connect to a centain device on the paired list.
 Argument         : the device number
 Return Value     : void
 Comment:		  : 
**********************************************************************************/
void BluetoothDrv_ReconnectLastDevice(uint8 dev)
{
    Bluetooth_Witron_command_send(AV_SLC_CONNECT_REQ_ID, 0, NULL);
}

/**********************************************************************************
 Purpose          :	Command to set the volume the tone
 Argument         : void
 Return Value     : void
 Comment:		  : It may be different from the audio cue volume
**********************************************************************************/
void BluetoothDrv_ToneVolumeSet(uint8 vol)
{
    uint8 tmp[2];
    tmp[0]=vol;
    tmp[1]=0;
    Bluetooth_Witron_command_send(GEN_SET_TONE_VOL_REQ, 2, tmp);
}


/**********************************************************************************
 Purpose          :	Command to set the volume of the true wireless paired device
 Argument         : void
 Return Value     : void
 Comment:		  : 
**********************************************************************************/
void BluetoothDrv_TrueWireless_volume_sync(uint8 vol)
{
    uint8 tmp[2];
    tmp[0]=vol;
    tmp[1]=0;
    Bluetooth_Witron_command_send(TRUEWIRELESS_SET_VOLUME_REQ_ID, 2, tmp);
}

/**********************************************************************************
 Purpose          :	Command to clear the Bluetooth paired list
 Argument         : void
 Return Value     : void
 Comment:		  : 
**********************************************************************************/
void BluetoothDrv_ResetPairedList(void)
{
    Bluetooth_Witron_command_send(GEN_RESET_PAIRED_LIST_REQ_ID, 0x0000, NULL);
}

/**********************************************************************************
 Purpose          :	Command to enter the DFU which the module can be upgrade by PC through
                    USB cable.
 Argument         : void
 Return Value     : void
 Comment:		  : 
**********************************************************************************/
void BluetoothDrv_EnterDfuMode(void)
{
    Bluetooth_Witron_command_send(GEN_ENTER_DFU_MODE_REQ_ID, 0x0000, NULL);
}


/**********************************************************************************
 Purpose          :	Command to direct connect bluetooth to a centain mac address
 Argument         : pointer to a string of bluetooth address in 6 character
 Return Value     :
 Comment:		  : eg the address is "28e02c7df4bf" the argument is uint8 address[6]="28e02c7df4bf"
**********************************************************************************/
void BluetoothDrv_DirectConnectAddress(const uint8* address)
{
    uint8 temp[6];
    temp[1] = convert_ascii2hex(address)*0x10+convert_ascii2hex(address+1); 
    address+=2;
    temp[0] = convert_ascii2hex(address)*0x10+convert_ascii2hex(address+1); 
    address+=2;
    temp[2] = convert_ascii2hex(address)*0x10+convert_ascii2hex(address+1); 
    address+=2;
    temp[5] = convert_ascii2hex(address)*0x10+convert_ascii2hex(address+1); 
    address+=2;
    temp[4] = convert_ascii2hex(address)*0x10+convert_ascii2hex(address+1); 
    address+=2;
    temp[3] = convert_ascii2hex(address)*0x10+convert_ascii2hex(address+1); 
    Bluetooth_Witron_command_send(GEN_CONNECT_ADDR_REQ, 0x0006, temp);
}

/**********************************************************************************
 Purpose          :	Command to Enter Bluetooth module test mode.
 Argument         : type of test mode
 Return Value     :
 Comment:		  : 
**********************************************************************************/
void BluetoothDrv_EnterLoopbackTestMode(eBtTestMode test_mode)
{
    uint8 tmp[2];
    if (test_mode>= END_BT_TEST_MODE)
        return;
    tmp[0] = bluetooth_test_mode_table[test_mode];
    tmp[1] = 0;

    Bluetooth_Witron_command_send(GEN_ENTER_TEST_MODE_REQ_ID, 0x0002, tmp);
}

/**********************************************************************************
 Purpose          :	Indicate the device battery level to iOS device.
 Argument         : Device device battery level(0-9)
 Return Value     :
 Comment:		  : 
**********************************************************************************/
void BluetoothDrv_BatteryIndicationRequest(uint8 level)
{
    uint8 tmp[2];
    if (level>9)
        return;
    tmp[0]=level;
    tmp[1]=0;
    Bluetooth_Witron_command_send(BATTERY_INDICATION_REQ_ID, 2, tmp);
}

/**********************************************************************************
 Purpose          :	Set the Handfree volume to a centain level.
 Argument         : Volume level
 Return Value     :
 Comment:		  : 
**********************************************************************************/
void BluetoothDrv_HfpVolumeSet(uint8 vol)
{
    uint8 tmp[2];
    tmp[0]=vol;
    tmp[1]=0;
    Bluetooth_Witron_command_send(HF_CHANGE_VOLUME_REQ_ID, 2, tmp);
}
/**********************************************************************************
 Purpose          :	Decode the bluetooth message received
 Argument         : pointer to the bluetooth message
 Return Value     :
 Comment:		  : Need to further define how to handle after getting the message
**********************************************************************************/
static void BluetoothDrv_decode_message(tBluetoothRxMessage* message)
{
    if ((message->id&0xff00)==BT_RSP_ID)
    {
        switch (message->id)
        {
            case A2DP_GET_STATUS_RSP_ID:
                // TODO: some stuff.
                break;
            case TRUEWIRELESS_PAIR_RSP_ID:
                // TODO: some stuff.
                break;
            case TRUEWIRELESS_SET_VOLUME_RSP_ID:
                // TODO: some stuff.
                break;
            case GEN_CONNECT_ADDR_RSP:
                // TODO: some stuff.
                break;
            default:
                break;
        }
    }
    else if ((message->id&0xff00)==BT_IND_ID)
    {
        switch (message->id)
        {
            case GEN_INIT_SUCCESS_IND:      /*0x0400*/
                // TODO: some stuff.
                break;
            case GEN_SHUTDOWN_COMPLETE_IND: /*0x0401*/
                // TODO: some stuff.
                break;
            case GEN_PAIRING_STATUS_IND:    /*0x0402*/
                switch(message->payload[0])
                {
                    case PAIRING_FAILED:
                        // TODO: some stuff.
                        break;
                    case PAIRING_SUCCESS:
                        // TODO: some stuff.
                        break;
                    case PAIRING_ENTER:
                        // TODO: some stuff.
                        break;
                    case PAIRING_EXIT:
                        // TODO: some stuff.
                        break;
                    default:
                        break;
                }
                break;
            case GEN_SCAN_ENABLE_IND:       /*0x0403*/
                // TODO: some stuff.
                break;
            case GEN_AUDIO_CODEC_IND:
                // TODO: some stuff.
                break;
            case GEN_CONNECTION_STATUS_IND:
                // TODO: some stuff.
                break;
            case GEN_GET_SOFTWARE_VER_IND:
                // TODO: some stuff.
                break;
            case HF_STATUS_IND:             /*0x0420*/
                // TODO: some stuff.
                break;
            case A2DP_STATUS_IND:           /*0x0440*/
                switch (message->payload[0])
                {
                    case A2DP_STATUS_CONNECTABLE_OR_DISCONNECTED:
                        // TODO: some stuff.
                        break;
                    case A2DP_STATUS_STREAMING:
                        // TODO: some stuff.
                        break;
                    case A2DP_STATUS_PAUSED:
                        // TODO: some stuff.
                        break;
                    case A2DP_STATUS_CONNECTED_PHONE_AND_SPEAKER:   
                        // TODO: some stuff.
                        break;
                    case A2DP_STATUS_CONNECTED_OTHER_SPEAKER_ONLY:  
                        // TODO: some stuff.
                        break;
                    case A2DP_STATUS_CONNECTED_PHONE_ONLY:
                        // TODO: some stuff.
                        break;
                    default:
                        break;
                }
                break;
                case AV_GET_VOLUME_RSP_ID:
                    // TODO: some stuff.
                    break;
                case A2DP_VOLUME_IND:    
                    // TODO: some stuff.
                    break;
                case GEN_STARTUP_RSP_ID:
                    // TODO: some stuff.
                    break;
                case GEN_GET_SW_VERSION_RSP:
                    // TODO: some stuff.
                    break;
                case GEN_TW_PAIRING_STATUS_IND:
                    // TODO: some stuff.
                    break;
                case GEN_TW_SHUTDOWN_IND:
                    // TODO: some stuff.
                    break;
                case GEN_TW_VOL_SYNC_IND:
                    // TODO: some stuff.
                    break;
                case HF_VOLUME_IND:
                    // TODO: some stuff.
                    break;
                default:
                    break;
        }
    }
}

/**********************************************************************************
 Purpose          :	Process the data in the ring buffer after a RX interrupt occured
                    parse the data to some meaningful message.
                    
 Argument         : 
 Return Value     :
 Comment:		  : This process should not be called within a interrupt routine.
**********************************************************************************/
void BluetoothDrv_process_uart_rx_parser()
{
    uint16 tmp_ch;
    static uint16 len=0,cnt=0,id=0;
    uint8 payload[MAX_PAYLOAD_LENGTH];
    bool Get_bt_message=0;
    uint8 tmp_pop_data=0;
    static uint8 parserState=RX_STATE_ID_LOW;
    tBluetoothRxMessage Bluetooth_RX_message;
    if (!RingBuf_IsEmpty(&rxBuf))
    {
        /* pop the data in the ring buffer */
        RingBuf_Pop(&rxBuf, &tmp_pop_data, 1); 
        tmp_ch = tmp_pop_data;
        /* increment parser pointer */
        switch(parserState)
        {
            case RX_STATE_ID_LOW: 
                id=tmp_ch;
                parserState++;
                break;
            case RX_STATE_ID_HIGH: 
                id|=(tmp_ch<<8);
                if ((id&0xff00)==0x0400 ||(id&0xff00)==0x0200/*||(id&0xff00)==0x0300*/)
                {
                    parserState++;
                }
                else
                {
                    parserState=RX_STATE_ID_LOW;
                }
                break;
            case RX_STATE_LEN_LOW:
                len=tmp_ch;
                parserState++;
                break;    
            case RX_STATE_LEN_HIGH: 
                len|=(tmp_ch<<8);
                if(len >= MAX_PAYLOAD_LENGTH)
                {
                    parserState=RX_STATE_ID_LOW;
                    return;
                }
                parserState++;
                cnt=0;
                if (len==0)
                {
                    parserState=RX_STATE_ID_LOW;
                    Get_bt_message=1;
                }
                break;
            case RX_STATE_PAYLOAD:
                if(cnt >= MAX_PAYLOAD_LENGTH )
                {
                    parserState=RX_STATE_ID_LOW;
                    return;
                }
                payload[cnt]=tmp_ch;
                cnt++;
                if (cnt>=len)
                {
                    parserState=RX_STATE_ID_LOW;
                    Get_bt_message=1;
                }
                break;
            default:
                parserState=RX_STATE_ID_LOW;
                break;
        }
        if (Get_bt_message)
        {
            Get_bt_message=0;
            Bluetooth_RX_message.id=id;
            Bluetooth_RX_message.len=len;
            Bluetooth_RX_message.payload = payload;
            BluetoothDrv_decode_message(&Bluetooth_RX_message);

        }
    }

}


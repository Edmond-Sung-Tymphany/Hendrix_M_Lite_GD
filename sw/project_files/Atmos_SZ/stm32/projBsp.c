/*
-------------------------------------------------------------------------------
TYMPHANY LTD





                  Public project Bsp interfaces
                  -------------------------

                  SW Module Document




@file        projBsp.h
@brief       This file implements the public project bsp interfaces which declared
             at projBsp.h
@author      Bob.Xu
@date        2014-07-14
@copyright (c) Tymphany Ltd. All rights reserved.

Change History:
VERSION    : 1    DRAFT      2014-06-12     Bob.Xu
DESCRIPTION: First Draft. Generated by newclass.py
SCO/ERROR  :
-------------------------------------------------------------------------------
*/
#include "stm32f0xx.h"
#include "trace.h"
#include "bsp.h"
#include "projBsp.h"
#include "attachedDevices.h"
#include "IoExpanderDrv.h"
#include "object_ids.h"
#include "signals.h"
/* On exception handler, interrupt is disabled, we can not use BSP_BlockingDelayMs()
 * But this delay is not accurary
 */
void BSP_ExpBlockingDelayMs(uint32 ms)
{
#if defined(INTERNAL_HIGH_SPEED_CLOCK)
    uint32 us= 1000 * ms; //8MHz CPU
#elif defined(EXTERNAL_HIGH_SPEED_CLOCK)
//    uint32 us= 6000 * ms; //48MHz CPU
    uint32 us= 4000 * ms; //32MHz CPU
#else
    error wrong clock setting
#endif

    while(us--)
    {
        asm("nop");
        asm("nop");
    }
}


void ProjBsp_CyclePrintError(char* errString)
{
    /* To be implemented */
    //ProjBsp_PrintError(); refer to polkAllplayer
    while((*errString)!='\0')
    {
        while(USART_GetFlagStatus(USART1, USART_FLAG_TXE) == RESET);
        USART_SendData(USART1, (*errString));
        errString++;
    }
}

void ProjBsp_JumpToBootloader(void)
{
    // fill in your project api. 
}


#ifdef PROJECT_SPEC_ASSERT_HANDLER
void ProjBsp_AssertHandler(char const * const file, int line)
{
#if 0   //ndef NDEBUG
    tIoeLedDevice *pIoeLedConfig = (tIoeLedDevice*) getDevicebyIdAndType(LED_DEV_ID, I2C_DEV_TYPE, NULL);      
    cIoExpanderDrv ioeDrv= {0};
    
    //turn off all LED
    IoExpanderDrv_Ctor(&ioeDrv, (const tDevice*)pIoeLedConfig->i2cDeviceConf);
    const tIoExpanderLedMap *ledMap= pIoeLedConfig->pIoExpanderLedMap;
    int i;
    for(i=0 ; i<pIoeLedConfig->ledNum ; i++)
    {		
        IoExpanderDrv_SetBrightness(&ioeDrv, ledMap[i].port, ledMap[i].pin, 0);
    }
#ifdef IOEXP_IS_AW9110B
    //Blink All LED
    IoExpanderDrv_AutoBlink(&ioeDrv, IOE_AUTO_PATT_ERROR);
#endif
#endif    
}
#endif

void ProjBsp_SysClkUpdate()
{
#ifdef EXTERNAL_HIGH_SPEED_CLOCK
  __IO uint32_t StartUpCounter = 0, HSEStatus = 0;
  
  /* Enable HSE */    
  RCC->CR |= ((uint32_t)RCC_CR_HSEON);
   
  /* Wait till HSE is ready and if Time out is reached exit */
  do
  {
    HSEStatus = RCC->CR & RCC_CR_HSERDY;
    StartUpCounter++;  
  } while((HSEStatus == 0) && (StartUpCounter != HSE_STARTUP_TIMEOUT));

  if ((RCC->CR & RCC_CR_HSERDY) != RESET)
  {
    HSEStatus = (uint32_t)0x01;
  }
  else
  {
    HSEStatus = (uint32_t)0x00;
  }  

  if (HSEStatus == (uint32_t)0x01)
  {
    /* Enable Prefetch Buffer and set Flash Latency */
    FLASH->ACR = FLASH_ACR_PRFTBE | FLASH_ACR_LATENCY;
 
    /* HCLK = SYSCLK/4 */
    RCC->CFGR |= (uint32_t)RCC_CFGR_HPRE_DIV4;
      
    /* PCLK = HCLK */
    RCC->CFGR |= (uint32_t)RCC_CFGR_PPRE_DIV1;

    /* PLL configuration = HSE(8MHz) * 4 = 32 MHz */
    RCC->CFGR &= (uint32_t)((uint32_t)~(RCC_CFGR_PLLSRC | RCC_CFGR_PLLXTPRE | RCC_CFGR_PLLMULL));

    /* config sysclk = 32M */
    RCC->CFGR |= (uint32_t)(RCC_CFGR_PLLSRC_PREDIV1 | RCC_CFGR_PLLXTPRE_PREDIV1 | RCC_CFGR_PLLMULL4);

    /* Enable PLL */
    RCC->CR |= RCC_CR_PLLON;

    /* Wait till PLL is ready */
    while((RCC->CR & RCC_CR_PLLRDY) == 0)
    {
    }

    /* Select PLL as system clock source */
    RCC->CFGR &= (uint32_t)((uint32_t)~(RCC_CFGR_SW));
    RCC->CFGR |= (uint32_t)RCC_CFGR_SW_PLL;    

    /* Wait till PLL is used as system clock source */
    while ((RCC->CFGR & (uint32_t)RCC_CFGR_SWS) != (uint32_t)RCC_CFGR_SWS_PLL)
    {
    }
  }
  else
  { /* If HSE fails to start-up, the application will have wrong clock 
         configuration. User can add here some code to deal with this error */
  }
#endif
}


/**************************************************/
/***************  interrupt funcs *********************/
/**************************************************/
/**
  * @brief  This function handles External line 0 interrupt request
  * @param  None
  * @retval None
  */

#ifdef HAS_INFRARED_KEY
// atmos board use PC3 as IR interrupt pin

#endif

void SetEnableWakeupSources()
{

}

void SetDisableWakeupSources()
{

}

/**************************************************/
/************ un-unsed interrupt funcs ****************/
/* User need to remove or fill in the specific function          */
/* if the interrupt is used                                                */
/**************************************************/

void RTC_IRQHandler()
{
    RTC_TimeTypeDef zeroTime = {0};

    if (RTC_GetITStatus(RTC_IT_ALRA) != RESET)
    {
        RTC_ClearITPendingBit(RTC_IT_ALRA);

        RTC_TimeStructInit(&zeroTime);
        RTC_SetTime(RTC_Format_BIN, &zeroTime);

#ifdef HAS_IWDG
        QEvt* pEvt = Q_NEW(QEvt, TIMER_FEED_WD_SIG);
        SendToServer(MAIN_APP_ID, (QEvt*)pEvt);
#endif
    }
    if(EXTI_GetITStatus(EXTI_Line17) != RESET)
    {
        EXTI_ClearITPendingBit(EXTI_Line17);
    }
}

/* When input 20seconds, RTC accurary execute every 16seconds
 * Is it a STM32 bug?
 */
void RTC_SetUpWakeUpAlarm(uint8 seconds)
{
    RTC_TimeTypeDef  alarmTime = {0};
    RTC_AlarmTypeDef alarm     = {0};
    RTC_TimeTypeDef  zeroTime  = {0};

    RTC_TimeStructInit(&alarmTime);
    RTC_AlarmStructInit(&alarm);
    RTC_TimeStructInit(&zeroTime);

    alarmTime.RTC_Seconds = seconds;
    RTC_SetTime(RTC_Format_BIN, &zeroTime);

    alarm.RTC_AlarmTime = alarmTime;
    alarm.RTC_AlarmMask = RTC_AlarmMask_DateWeekDay | RTC_AlarmMask_Hours | RTC_AlarmMask_Minutes;

    RTC_SetAlarm(RTC_Format_BIN, RTC_Alarm_A, &alarm);

    RTC_OutputConfig(RTC_Output_Disable, RTC_OutputPolarity_Low);
    RTC_ITConfig(RTC_IT_ALRA, ENABLE);
    RTC_AlarmCmd(RTC_Alarm_A, ENABLE);
    RTC_ClearFlag(RTC_FLAG_ALRAF);
}

void RTC_Initialize()
{
    RTC_InitTypeDef rtc = {0};
    EXTI_InitTypeDef exti = {0};
    NVIC_InitTypeDef NVIC_InitStructure = {0};

    RCC_APB1PeriphClockCmd(RCC_APB1Periph_PWR, ENABLE);

    PWR_BackupAccessCmd(ENABLE);

    RCC_BackupResetCmd(ENABLE);
    RCC_BackupResetCmd(DISABLE);

    RCC_LSICmd(ENABLE);
    RCC_RTCCLKConfig(RCC_RTCCLKSource_LSI);
    RCC_RTCCLKCmd(ENABLE);

    RTC_StructInit(&rtc);

    /*
        ck_spre = RTCCLK/((PREDIV_A+1) * (PREDIV_B+1))
        40kHz/(99+1)*(399+1) = 1
    */
    rtc.RTC_AsynchPrediv = 0x63;
    rtc.RTC_SynchPrediv  = 0x18F;

    RTC_Init(&rtc);

    EXTI_ClearITPendingBit(EXTI_Line17);

    EXTI_StructInit(&exti);
    exti.EXTI_Line = EXTI_Line17;
    exti.EXTI_Mode = EXTI_Mode_Interrupt;
    exti.EXTI_Trigger = EXTI_Trigger_Rising;
    exti.EXTI_LineCmd = ENABLE;
    EXTI_Init(&exti);

    NVIC_InitStructure.NVIC_IRQChannel = RTC_IRQn;
    NVIC_InitStructure.NVIC_IRQChannelPriority = 0;
    NVIC_InitStructure.NVIC_IRQChannelCmd = ENABLE;
    NVIC_Init(&NVIC_InitStructure);
}


/*
-------------------------------------------------------------------------------
TYMPHANY LTD





                  Public project Bsp interfaces
                  -------------------------

                  SW Module Document




@file        projBsp.h
@brief       This file implements the public project bsp interfaces which declared
             at projBsp.h
@author      Bob.Xu
@date        2014-07-14
@copyright (c) Tymphany Ltd. All rights reserved.

Change History:
VERSION    : 1    DRAFT      2014-06-12     Bob.Xu
DESCRIPTION: First Draft. Generated by newclass.py
SCO/ERROR  :
-------------------------------------------------------------------------------
*/
#include "stm32f0xx.h"

#include "bsp.h"
#ifdef HAS_BLUETOOTH
#include "BluetoothDrv.h"
#endif

#define MIN_SEND_INTERVAL_MS (50)

static QActive* pSender = NULL;

static void SetExtInterrupt(uint8 port, uint8 pin, uint32 extiLine,
                                                  EXTITrigger_TypeDef type, IRQn_Type irq, FunctionalState state);

/*****************************************************************************************************************
 *
 *  Interrupt functions
 *
 *****************************************************************************************************************/
/**
  * @brief  This function handles External line 0 interrupt request
  * @param  None
  * @retval None
  */
void EXTI4_15_IRQHandler(void)
{
    if(EXTI_GetITStatus(EXTI_Line14) != RESET)
    {
        EXTI_ClearITPendingBit(EXTI_Line14);
#ifdef HAS_BLUETOOTH
        BluetoothDrv_Led0_IRQ_Handler();
#endif
    }
    if(EXTI_GetITStatus(EXTI_Line15) != RESET)
    {
        EXTI_ClearITPendingBit(EXTI_Line15);
#ifdef HAS_BLUETOOTH
        BluetoothDrv_Led1_IRQ_Handler();
#endif
    }
}

void EXTI2_3_IRQHandler(void)
{
    if(EXTI_GetITStatus(EXTI_Line2) != RESET)
    {
        EXTI_ClearITPendingBit(EXTI_Line2);
         QEvt* evt = Q_NEW(QEvt, POWER_SWITCH_INT_SIG);
        QACTIVE_POST(pSender, evt, 0);
     }
}

void EXTI0_1_IRQHandler(void)
{
    if(EXTI_GetITStatus(EXTI_Line0) != RESET)
    {
        EXTI_ClearITPendingBit(EXTI_Line0);
        QEvt* evt = Q_NEW(QEvt, DC_IN_INT_SIG);
        QACTIVE_POST(pSender, evt, 0);
    }
}


void SetSender(QActive* sender)
{
    pSender = sender;
}

void ProjBsp_SysClkUpdate()
{
}

void SetDisableWakeupSources()
{
    SetExtInterrupt(EXTI_PortSourceGPIOA, EXTI_PinSource2,
               EXTI_Line2, EXTI_Trigger_Rising_Falling, EXTI2_3_IRQn, DISABLE);

    SetExtInterrupt(EXTI_PortSourceGPIOB, EXTI_PinSource0,
                   EXTI_Line0, EXTI_Trigger_Rising, EXTI0_1_IRQn, DISABLE);
}

static void SetExtInterrupt(uint8 port, uint8 pin, uint32 extiLine,
                                                  EXTITrigger_TypeDef type, IRQn_Type irq, FunctionalState state)
{
    /* Enable the interrupts */
    EXTI_InitTypeDef   EXTI_InitStructure;
    NVIC_InitTypeDef   NVIC_InitStructure;

    /* Connect EXTI Line to gpio pin */
    SYSCFG_EXTILineConfig(port, pin);
    /* Configure EXTI line */
    EXTI_InitStructure.EXTI_Line = extiLine;
    EXTI_InitStructure.EXTI_Mode = EXTI_Mode_Interrupt;
    EXTI_InitStructure.EXTI_Trigger = type;
    EXTI_InitStructure.EXTI_LineCmd = state;
    EXTI_Init(&EXTI_InitStructure);
    /* Enable and set EXTI Interrupt */
    NVIC_InitStructure.NVIC_IRQChannel = irq;
    NVIC_InitStructure.NVIC_IRQChannelPriority = 0x00;
    NVIC_InitStructure.NVIC_IRQChannelCmd = state;
    NVIC_Init(&NVIC_InitStructure);
}

void SetEnableWakeupSources(void)
{
    //disable it for now
    //PowerDrv_DisableEXTI_Config();

    GPIO_InitTypeDef GPIO_InitStructure;
    /* Initial GPIO for AC interrupt as it's used for ADC in running time*/
    RCC_AHBPeriphClockCmd(RCC_AHBPeriph_GPIOA, ENABLE);

    GPIO_InitStructure.GPIO_Mode = GPIO_Mode_IN;
    GPIO_InitStructure.GPIO_Speed = GPIO_Speed_50MHz;
    GPIO_InitStructure.GPIO_PuPd = GPIO_PuPd_NOPULL;
    GPIO_InitStructure.GPIO_Pin = GPIO_Pin_2;
    GPIO_Init(GPIOA, &GPIO_InitStructure);

    /* Power Key input */
    /* Initial and power key to PA2 pin*/
    SetExtInterrupt(EXTI_PortSourceGPIOA, EXTI_PinSource2,
                   EXTI_Line2, EXTI_Trigger_Rising_Falling, EXTI2_3_IRQn, ENABLE);


    /* Initial GPIO for AC interrupt as it's used for ADC in running time*/
    RCC_AHBPeriphClockCmd(RCC_AHBPeriph_GPIOB, ENABLE);

    GPIO_InitStructure.GPIO_Mode = GPIO_Mode_IN;
    GPIO_InitStructure.GPIO_Speed = GPIO_Speed_50MHz;
    GPIO_InitStructure.GPIO_PuPd = GPIO_PuPd_NOPULL;
    GPIO_InitStructure.GPIO_Pin = GPIO_Pin_0;
    GPIO_Init(GPIOB, &GPIO_InitStructure);

    /* DC input */
    /* Initial and power key to PB0 pin*/
    SetExtInterrupt(EXTI_PortSourceGPIOB, EXTI_PinSource0,
                   EXTI_Line0, EXTI_Trigger_Rising, EXTI0_1_IRQn, ENABLE);

}




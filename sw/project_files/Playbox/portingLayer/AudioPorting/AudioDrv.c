/*
-------------------------------------------------------------------------------
TYMPHANY LTD





                  Audio Driver
                  -------------------------

                  SW Module Document
 
@file        AudioDrv.c
@brief       This file implementes the middle layer of the audio service 
@author      Bob.Xu 
@date        2015-06-15
@copyright (c) Tymphany Ltd. All rights reserved.

Change History:
VERSION    : 1    DRAFT      2015-06-15     Bob.Xu 
DESCRIPTION: First Draft. Generated by newclass.py
SCO/ERROR  : 
-------------------------------------------------------------------------------
*/

#include "./AudioDrv_priv.h"
#include "SettingSrv.h"
#include "trace.h"
#include "AudioSrv.h"
#include "I2CDrv.h"
#include "DspDrv_tas5754.h"
#include "pcm1862Drv.h"

typedef struct tCtrIdEQIdMap
{
    eAudioSettId dspSettid;
    eSettingId settingId;
}tCtrIdEQIdMap;

static tCtrIdEQIdMap ctrIdEQIdMap[] =
{
    /* DSP setting ID  index of setting db*/
    {DSP_VOLUME_SETT_ID,  SETID_VOLUME},

};

static cI2CDrv          Tas5754i2cObj;
static cDSPDrv_tas5754  DspTas5754;

static cI2CDrv          Pcm1862i2cObj;
static cAdcDrv_pcm1862  AdcPcm1862;

static void AudioDrv_DspVolSetId_Handler(void);

/* Private functions / variables. Declare and drivers here */

/*****************************************************************************************************************
 *
 * Start-up / shut-down functions
 *
 *****************************************************************************************************************/
void AudioDrv_Ctor(cAudioDrv *me)
{
    uint16 device_index = 0;

    ASSERT(me);
    Tas5754i2cObj.pConfig = (tI2CDevice*)getDevicebyId(DSP_DEV_ID,&device_index);
    DSPDrv_tas5754_Ctor(&DspTas5754,&Tas5754i2cObj);

    Pcm1862i2cObj.pConfig = (tI2CDevice*)getDevicebyId(DSP_DEV_ID,&device_index);
    AdcDrv_pcm1862_Ctor(&AdcPcm1862, &Pcm1862i2cObj);
}

void AudioDrv_Xtor(cAudioDrv *me)
{
    AdcDrv_pcm1862_Xtor(&AdcPcm1862);
    DSPDrv_tas5754_Xtor(&DspTas5754);
    /* Fill me in! */
}

BOOL AudioDrv_Init(cAudioDrv *me)
{
    if(!(me->drvIsReady))
    {
        me->nextDelayTime = DSPDrv_tas5754_Init(&DspTas5754);
        if(me->nextDelayTime == 0)
        {
            AdcDrv_pcm1862_Init(&AdcPcm1862);
            me->drvIsReady = TRUE;
            return TRUE;
        }
        else
        {
            return FALSE;
        }
    }
    return TRUE;
}

void AudioDrv_Reset(cAudioDrv *me)
{
    me->drvIsReady = FALSE;
}
/*****************************************************************************************************************
 *
 * Public functions
 *
 *****************************************************************************************************************/
/**
 * Function to change the channel. To call this function, normally you have to
 * call AudioDrv_Mute to mute the system in order to avoid pop noise, then set 
 * the channel and last,call AudioDrv_Mute to umute the system
 * @param[in]     theChannelToSet, the channel which will replace the current channel
 */
void AudioDrv_SetChannel(eAudioChannel audioChannel)
{
    if (AUDIO_CHANNEL_AUXIN == audioChannel)
    {
        AdcDrv_pcm1862_SetInput(&AdcPcm1862, PCM1862_ANALOG_DIFF_INPUT1);
    }
    else if (AUDIO_CHANNEL_RCA == audioChannel)
    {
        AdcDrv_pcm1862_SetInput(&AdcPcm1862, PCM1862_ANALOG_DIFF_INPUT1);
    }
    else{}
}

/**
 * Function to update audio status including jackin status,  music steam status and so on.
 */
void AudioDrv_UpdateStatus(cAudioDrv *audioDrvObj)
{
    AudioDrv_CheckJackInStatus();
    AudioDrv_CheckMusicStreamStatus();
}

void AudioDrv_CheckJackInStatus(void)
{
    
}

/**
 * Function to update the music stream status
 */
void AudioDrv_CheckMusicStreamStatus(void)
{
    AudioMusicDetectStateEvt* pAudioMusicStateEvt;
    pAudioMusicStateEvt = Q_NEW(AudioMusicDetectStateEvt, AUDIO_MUSIC_STREAM_STATE_SIG);
    QF_PUBLISH(&pAudioMusicStateEvt->super, dummy);
}

/**
 * Function to change audio settings, such as EQ.
 * @param[in]     pAudioEvt, a pointer of the audio event
 */
void AudioDrv_SetAudio(cAudioDrv *me, eAudioSettId audioSettId, BOOL enabled, uint32 param)
{
    ASSERT(audioSettId < AUDIO_SETT_ID_MAX);

    switch (audioSettId)
    {
        case DSP_VOLUME_SETT_ID:
             AudioDrv_DspVolSetId_Handler();
             break;

        case SYSTEM_GAIN_SETT_ID:
            AdcDrv_pcm1862_SetPGA(&AdcPcm1862, 0x10);
            break;
        default:
             break;
    }
}

/**
 * Function to mute the system.
 * @param[in]   muteType    This parameter defines the way of how to mute the system,
 * you could mute the input source, or mute by dsp or mute the output
 * @param[in]   muteEnable  mute or unmute
 */
void AudioDrv_Mute(eAudioMuteType muteType, bool muteEnable)
{
    DSPDrv_tas5754_Mute(&DspTas5754,muteType,muteEnable);
}

static void AudioDrv_DspVolSetId_Handler(void)
{
    uint8 volumeLevel = MIN_VOLUME;

    volumeLevel =  *(uint8*)Setting_Get(ctrIdEQIdMap[DSP_VOLUME_SETT_ID].settingId);
    if(volumeLevel <= MAX_VOLUME && volumeLevel >= MIN_VOLUME)
    {
        DSPDrv_tas5754_Volume(&DspTas5754, volumeLevel);
    }
}

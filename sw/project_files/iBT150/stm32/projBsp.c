/*
-------------------------------------------------------------------------------
TYMPHANY LTD





                  Public project Bsp interfaces
                  -------------------------

                  SW Module Document




@file        projBsp.h
@brief       This file implements the public project bsp interfaces which declared
             at projBsp.h
@author      Bob.Xu
@date        2014-07-14
@copyright (c) Tymphany Ltd. All rights reserved.

Change History:
VERSION    : 1    DRAFT      2014-06-12     Bob.Xu
DESCRIPTION: First Draft. Generated by newclass.py
SCO/ERROR  :
-------------------------------------------------------------------------------
*/
#include "stm32f0xx.h"

#include "bsp.h"
#include "projBsp.h"
#include "BluetoothDrv.h"

static bool isBtInterruptEnable = FALSE;


void ProjBsp_CyclePrintError(char* errString)
{
    /* To be implemented */
    //ProjBsp_PrintError(); refer to polkAllplayer
}
 /* initial the pin interrupt */
void EXTI_Config(bool isTurnOnInterrupt)
{
    EXTI_InitTypeDef   EXTI_InitStructure;
    NVIC_InitTypeDef   NVIC_InitStructure;

    /* Enable SYSCFG clock */
    RCC_APB2PeriphClockCmd(RCC_APB2Periph_SYSCFG, ENABLE);

   #ifdef BT_CODEC_STATUS_CHECK
    BluetoothDrv_EnableCodecStatus(isTurnOnInterrupt);
   #endif

    /* Connect EXTI14 Line to PB14 pin */
    SYSCFG_EXTILineConfig(EXTI_PortSourceGPIOB, EXTI_PinSource14);
    /* Connect EXTI15 Line to PB15 pin */
    SYSCFG_EXTILineConfig(EXTI_PortSourceGPIOB, EXTI_PinSource15);
#ifdef BT_NFC_PAIR
    /* Connect EXTI7 Line to PA7 pin */
    SYSCFG_EXTILineConfig(EXTI_PortSourceGPIOA, EXTI_PinSource7);
    EXTI_InitStructure.EXTI_Line = EXTI_Line14 | EXTI_Line15 | EXTI_Line7;
#else
    EXTI_InitStructure.EXTI_Line = EXTI_Line14 | EXTI_Line15;
#endif
    EXTI_InitStructure.EXTI_Mode = EXTI_Mode_Interrupt;
    EXTI_InitStructure.EXTI_Trigger = EXTI_Trigger_Rising_Falling;
    if(isTurnOnInterrupt)
    {
        isBtInterruptEnable = TRUE;
        EXTI_InitStructure.EXTI_LineCmd = ENABLE;
    }
    else
    {
        isBtInterruptEnable = FALSE;
        EXTI_InitStructure.EXTI_LineCmd = DISABLE;
    }
    EXTI_Init(&EXTI_InitStructure);

    /* Enable and set Interrupt */
    NVIC_InitStructure.NVIC_IRQChannel = EXTI4_15_IRQn;
    NVIC_InitStructure.NVIC_IRQChannelPriority = 0x00;
    NVIC_InitStructure.NVIC_IRQChannelCmd = ENABLE;
    NVIC_Init(&NVIC_InitStructure);
}


void EXTI4_15_IRQHandler(void)
{
    if(EXTI_GetITStatus(EXTI_Line14) != RESET)
    {
        EXTI_ClearITPendingBit(EXTI_Line14);
        BluetoothDrv_ReadBtLedStatus(BT_INPUT0);
    }
    if(EXTI_GetITStatus(EXTI_Line15) != RESET)
    {
        EXTI_ClearITPendingBit(EXTI_Line15);
        if(isBtInterruptEnable)
        { /*it's BT LED1 interrupt*/
            BluetoothDrv_ReadBtLedStatus(BT_INPUT1);
        }
#ifdef HAS_BATTERY
        else
        { /*it's power driver Micro USB interrupt*/
            PowerDrv_HandleDcDetInterrupt();
        }
#endif
    }
#ifdef BT_NFC_PAIR
    if(EXTI_GetITStatus(EXTI_Line7) != RESET)
    {
        EXTI_ClearITPendingBit(EXTI_Line7);

    }
#endif
#ifdef HAS_BATTERY
    if(EXTI_GetITStatus(EXTI_Line6) != RESET)
    {  /*it's power driver DC plug in interrupt*/
        EXTI_ClearITPendingBit(EXTI_Line6);
        PowerDrv_HandleDcDetInterrupt();
    }
#endif
}



void SetEnableCodecStatus(bool bEnable)
{
    EXTI_InitTypeDef   EXTI_InitStructure;
    NVIC_InitTypeDef   NVIC_InitStructure;

    RCC_APB2PeriphClockCmd(RCC_APB2Periph_SYSCFG, ENABLE);
    /* Codec Status */
    SYSCFG_EXTILineConfig(EXTI_PortSourceGPIOB, EXTI_PinSource3);
    /* Configure EXTI3 line to PB3 */
    EXTI_InitStructure.EXTI_Line = EXTI_Line3;
    EXTI_InitStructure.EXTI_Mode = EXTI_Mode_Interrupt;
    EXTI_InitStructure.EXTI_Trigger = EXTI_Trigger_Rising_Falling;
     if(bEnable)
        EXTI_InitStructure.EXTI_LineCmd = ENABLE;
    else
	EXTI_InitStructure.EXTI_LineCmd = DISABLE;
    EXTI_Init(&EXTI_InitStructure);

    /* Enable and set EXTI3 Interrupt */
    NVIC_InitStructure.NVIC_IRQChannel = EXTI2_3_IRQn;
    NVIC_InitStructure.NVIC_IRQChannelPriority = 0x00;
     if(bEnable)
        NVIC_InitStructure.NVIC_IRQChannelCmd = ENABLE;
     else
        NVIC_InitStructure.NVIC_IRQChannelCmd = DISABLE;
    NVIC_Init(&NVIC_InitStructure);

}

/*
-------------------------------------------------------------------------------
TYMPHANY LTD





                  Public project Bsp interfaces
                  -------------------------

                  SW Module Document




@file        projBsp.h
@brief       This file implements the public project bsp interfaces which declared
             at projBsp.h
@author      Bob.Xu
@date        2014-07-14
@copyright (c) Tymphany Ltd. All rights reserved.

Change History:
VERSION    : 1    DRAFT      2014-06-12     Bob.Xu
DESCRIPTION: First Draft. Generated by newclass.py
SCO/ERROR  :
-------------------------------------------------------------------------------
*/
#include "stm32f0xx.h"

#include "bsp.h"
#include "projBsp.h"
#include "BluetoothDrv.h"
#include "powerDrv.h"
#include "KeySrv.h"

static bool isBtInterruptEnable = FALSE;

void ProjBsp_CyclePrintError(char* errString)
{
    /* To be implemented */
    //ProjBsp_PrintError(); refer to polkAllplayer
}

 /* initial the pin interrupt */
void EXTI_Config(bool isTurnOnInterrupt)
{
      EXTI_InitTypeDef   EXTI_InitStructure;
      NVIC_InitTypeDef   NVIC_InitStructure;
     
      /* Enable SYSCFG clock */
      RCC_APB2PeriphClockCmd(RCC_APB2Periph_SYSCFG, ENABLE);
     
#ifdef BT_CODEC_STATUS_CHECK
      BluetoothDrv_EnableCodecStatus(isTurnOnInterrupt);
#endif     
      SYSCFG_EXTILineConfig(EXTI_PortSourceGPIOA, EXTI_PinSource12);
      SYSCFG_EXTILineConfig(EXTI_PortSourceGPIOA, EXTI_PinSource11);
      EXTI_InitStructure.EXTI_Line = EXTI_Line12 | EXTI_Line11;
      EXTI_InitStructure.EXTI_Mode = EXTI_Mode_Interrupt;
      EXTI_InitStructure.EXTI_Trigger = EXTI_Trigger_Rising_Falling;
      if(isTurnOnInterrupt)
      {
          isBtInterruptEnable = TRUE;
          EXTI_InitStructure.EXTI_LineCmd = ENABLE;
      }
      else
      {
          isBtInterruptEnable = FALSE;
          EXTI_InitStructure.EXTI_LineCmd = DISABLE;
      }
      EXTI_Init(&EXTI_InitStructure);
     
      /* Enable and set Interrupt */
      NVIC_InitStructure.NVIC_IRQChannel = EXTI4_15_IRQn;
      NVIC_InitStructure.NVIC_IRQChannelPriority = 0x00;
      NVIC_InitStructure.NVIC_IRQChannelCmd = ENABLE;
      NVIC_Init(&NVIC_InitStructure);
}

/**
  * @brief  This function handles External line 0 interrupt request
  * @param  None
  * @retval None
  */
void EXTI0_1_IRQHandler(void)
{
    if(EXTI_GetITStatus(EXTI_Line1) != RESET)
    {
        EXTI_ClearITPendingBit(EXTI_Line1);

        KeyEvtFromDrv *pte = Q_NEW(KeyEvtFromDrv,WAKE_UP_KEY_INTERRUPT_SIG);
        pte->keyId = POWER_KEY;
        SendToServer(KEY_SRV_ID, (QEvt*)pte);
    }
}
void EXTI4_15_IRQHandler(void)
{
    if(EXTI_GetITStatus(EXTI_Line12) != RESET)
    {
        EXTI_ClearITPendingBit(EXTI_Line12);
        BluetoothDrv_ReadBtLedStatus(BT_INPUT0);
    }
    if(EXTI_GetITStatus(EXTI_Line11) != RESET)
    {
        EXTI_ClearITPendingBit(EXTI_Line11);
        if(isBtInterruptEnable)
        {
            BluetoothDrv_ReadBtLedStatus(BT_INPUT1);
        }
    }    
}
static void PowerDrv_SetExtInterrupt(uint8 port, uint8 pin, uint32 extiLine,
                                                  EXTITrigger_TypeDef type, IRQn_Type irq, FunctionalState state)
{
    /* Enable the interrupts */
    EXTI_InitTypeDef   EXTI_InitStructure;
    NVIC_InitTypeDef   NVIC_InitStructure;

    /* Connect EXTI Line to gpio pin */
    SYSCFG_EXTILineConfig(port, pin);
    /* Configure EXTI line */
    EXTI_InitStructure.EXTI_Line = extiLine;
    EXTI_InitStructure.EXTI_Mode = EXTI_Mode_Interrupt;
    EXTI_InitStructure.EXTI_Trigger = type;
    EXTI_InitStructure.EXTI_LineCmd = state;
    EXTI_Init(&EXTI_InitStructure);

    /* Enable and set EXTI Interrupt */
    NVIC_InitStructure.NVIC_IRQChannel = irq;
    NVIC_InitStructure.NVIC_IRQChannelPriority = 0x00;
    NVIC_InitStructure.NVIC_IRQChannelCmd = state;
    NVIC_Init(&NVIC_InitStructure);
}


void SetEnableWakeupSources()
{
    //disable it for now
    //PowerDrv_DisableEXTI_Config();
    GPIO_InitTypeDef GPIO_InitStructure;
    /* Initial GPIO for AC interrupt as it's used for ADC in running time*/
    RCC_AHBPeriphClockCmd(RCC_AHBPeriph_GPIOA, ENABLE);

    GPIO_InitStructure.GPIO_Mode = GPIO_Mode_IN;
    GPIO_InitStructure.GPIO_Speed = GPIO_Speed_50MHz;
    GPIO_InitStructure.GPIO_PuPd = GPIO_PuPd_NOPULL;
    GPIO_InitStructure.GPIO_Pin = GPIO_Pin_1;
    GPIO_Init(GPIOA, &GPIO_InitStructure);

    /* Initial and Enable power Key interrupt */
    PowerDrv_SetExtInterrupt(EXTI_PortSourceGPIOA, EXTI_PinSource1,
               EXTI_Line1, EXTI_Trigger_Falling, EXTI0_1_IRQn, ENABLE);
}
void SetEnableCodecStatus(bool bEnable)
{
    EXTI_InitTypeDef   EXTI_InitStructure;
    NVIC_InitTypeDef   NVIC_InitStructure;

    RCC_APB2PeriphClockCmd(RCC_APB2Periph_SYSCFG, ENABLE);
    /* Codec Status */
    SYSCFG_EXTILineConfig(EXTI_PortSourceGPIOB, EXTI_PinSource0);
    /* Configure EXTI0 line to PB0 */
    EXTI_InitStructure.EXTI_Line = EXTI_Line0;
    EXTI_InitStructure.EXTI_Mode = EXTI_Mode_Interrupt;
    EXTI_InitStructure.EXTI_Trigger = EXTI_Trigger_Rising_Falling;
     if(bEnable)
        EXTI_InitStructure.EXTI_LineCmd = ENABLE;
    else
        EXTI_InitStructure.EXTI_LineCmd = DISABLE;
    EXTI_Init(&EXTI_InitStructure);

    /* Enable and set EXTI0 Interrupt */
    NVIC_InitStructure.NVIC_IRQChannel = EXTI0_1_IRQn;
    NVIC_InitStructure.NVIC_IRQChannelPriority = 0x00;
     if(bEnable)
        NVIC_InitStructure.NVIC_IRQChannelCmd = ENABLE;
     else
        NVIC_InitStructure.NVIC_IRQChannelCmd = DISABLE;
    NVIC_Init(&NVIC_InitStructure);

}

void SetDisableWakeupSources()
{
    PowerDrv_SetExtInterrupt(EXTI_PortSourceGPIOA, EXTI_PinSource1,
               EXTI_Line1, EXTI_Trigger_Falling, EXTI0_1_IRQn, DISABLE);
}
void ProjBsp_SysClkUpdate()
{
}